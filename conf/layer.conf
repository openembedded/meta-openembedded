## conf/layer.conf
```bitbake
# We have a conf and classes directory, prepend to BBPATH to prefer our versions
BBPATH := "${LAYERDIR}:${BBPATH}"

# We have a recipes directory, add to BBFILES
BBFILES := "${BBFILES} ${LAYERDIR}/recipes-*/*/*.bb ${LAYERDIR}/recipes-*/*/*.bbappend"

BBFILE_COLLECTIONS += "openembedded-layer"
BBFILE_PATTERN_openembedded-layer := "^${LAYERDIR}/"
BBFILE_PRIORITY_openembedded-layer = "6"
```

## conf/machine/include/tune-arm926ejs.inc
```bitbake
FEED_ARCH = "armv5te"
PACKAGE_EXTRA_ARCHS += "armv4 armv4t armv5te"
# For gcc 3.x you need:
#TARGET_CC_ARCH = "-march=armv5te -mtune=arm926ejs"
# For gcc 4.x you need:
TARGET_CC_ARCH = "-march=armv5te -mtune=arm926ej-s"
BASE_PACKAGE_ARCH = "armv5te"
```

## meta-efl/conf/distro/include/efl-from-svn.inc
```bitbake
EFL_PREFERRED_VERSION ?= "1.2.0+svn%"
EFL_PREFERRED_VERSION_1.0 ?= "1.0.0+svn%"
EFL_PREFERRED_VERSION_EET ?= "1.6.0+svn%"

PREFERRED_VERSION_ecore ?= "${EFL_PREFERRED_VERSION}"
PREFERRED_VERSION_ecore-native ?= "${EFL_PREFERRED_VERSION}"
PREFERRED_VERSION_edbus ?= "${EFL_PREFERRED_VERSION}"
PREFERRED_VERSION_edbus-native ?= "${EFL_PREFERRED_VERSION}"
PREFERRED_VERSION_edje ?= "${EFL_PREFERRED_VERSION}"
PREFERRED_VERSION_edje-native ?= "${EFL_PREFERRED_VERSION}"
PREFERRED_VERSION_edje-nativesdk ?= "${EFL_PREFERRED_VERSION}"
PREFERRED_VERSION_eeze ?= "${EFL_PREFERRED_VERSION}"
PREFERRED_VERSION_eeze-native ?= "${EFL_PREFERRED_VERSION}"
PREFERRED_VERSION_efreet ?= "${EFL_PREFERRED_VERSION}"
PREFERRED_VERSION_efreet-native ?= "${EFL_PREFERRED_VERSION}"
PREFERRED_VERSION_eina ?= "${EFL_PREFERRED_VERSION}"
PREFERRED_VERSION_eina-native ?= "${EFL_PREFERRED_VERSION}"
PREFERRED_VERSION_embryo ?= "${EFL_PREFERRED_VERSION}"
PREFERRED_VERSION_embryo-native ?= "${EFL_PREFERRED_VERSION}"
PREFERRED_VERSION_evas ?= "${EFL_PREFERRED_VERSION}"
PREFERRED_VERSION_evas-native ?= "${EFL_PREFERRED_VERSION}"
PREFERRED_VERSION_expedite ?= "${EFL_PREFERRED_VERSION}"
PREFERRED_VERSION_expedite-native ?= "${EFL_PREFERRED_VERSION}"

PREFERRED_VERSION_eet ?= "${EFL_PREFERRED_VERSION_EET}"
PREFERRED_VERSION_eet-native ?= "${EFL_PREFERRED_VERSION_EET}"

PREFERRED_VERSION_eio ?= "${EFL_PREFERRED_VERSION_1.0}"
PREFERRED_VERSION_eio-native ?= "${EFL_PREFERRED_VERSION_1.0}"
PREFERRED_VERSION_emotion ?= "${EFL_PREFERRED_VERSION_1.0}"
PREFERRED_VERSION_ethumb ?= "${EFL_PREFERRED_VERSION_1.0}"
PREFERRED_VERSION_elementary ?= "${EFL_PREFERRED_VERSION_1.0}"
```

## meta-efl/conf/layer.conf
```bitbake
# We have a conf and classes directory, append to BBPATH 
BBPATH .= ":${LAYERDIR}"

# We have a recipes directory, add to BBFILES
BBFILES += "${LAYERDIR}/recipes-*/*/*.bb ${LAYERDIR}/recipes-*/*/*.bbappend"

BBFILE_COLLECTIONS += "efl-layer"
BBFILE_PATTERN_efl-layer := "^${LAYERDIR}/"
BBFILE_PRIORITY_efl-layer = "7"

E_MIRROR = "http://download.enlightenment.org/releases"
E_RELEASES = "http://download.enlightenment.org/rel"
E_SVN = "svn://svn.enlightenment.org/svn/e"
```

## meta-gnome/conf/layer.conf
```bitbake
# We have a conf and classes directory, append to BBPATH
BBPATH .= ":${LAYERDIR}"

# We have a recipes directory, add to BBFILES
BBFILES += "${LAYERDIR}/recipes-*/*/*.bb ${LAYERDIR}/recipes-*/*/*.bbappend"

BBFILE_COLLECTIONS += "gnome-layer"
BBFILE_PATTERN_gnome-layer := "^${LAYERDIR}/"
BBFILE_PRIORITY_gnome-layer = "7"
```

## meta-initramfs/conf/layer.conf
```bitbake
# Layer configuration for meta-initramfs layer

# We have a conf and classes directory, prepend to BBPATH to prefer our versions
BBPATH := "${LAYERDIR}:${BBPATH}"

# We have a recipes directory, add to BBFILES
BBFILES := "${BBFILES} ${LAYERDIR}/recipes-*/*/*.bb ${LAYERDIR}/recipes-*/*/*.bbappend"

BBFILE_COLLECTIONS += "meta-initramfs"
BBFILE_PATTERN_meta-initramfs := "^${LAYERDIR}/"
BBFILE_PRIORITY_meta-initramfs = "8"
```

## meta-networking/conf/distro/include/meta_networking_security_flags.inc
```bitbake
# configure righteously complains:
# | configure:3479: using CFLAGS:  -O2 -pipe -g -feliminate-unused-debug-types -fstack-protector-strong -pie -fpie -D_FORTIFY_SOURCE=2
# | configure:3485: CFLAGS error: CFLAGS may only be used to specify C compiler flags, not macro definitions. Use CPPFLAGS for: -D_FORTIFY_SOURCE=2
# | configure:3516: error: Can not continue. Fix errors mentioned immediately above this line.
TARGET_CFLAGS_remove_pn-c-ares = "${lcl_maybe_fortify}"
TARGET_CPPFLAGS_append_pn-c-ares = "${lcl_maybe_fortify}"
```

## meta-networking/conf/layer.conf
```bitbake
# We have a conf and classes directory, add to BBPATH
BBPATH .= ":${LAYERDIR}"

# We have a packages directory, add to BBFILES
BBFILES += "${LAYERDIR}/recipes-*/*/*.bb \
            ${LAYERDIR}/recipes-*/*/*.bbappend"

BBFILE_COLLECTIONS += "networking"
BBFILE_PATTERN_networking := "^${LAYERDIR}/"
BBFILE_PRIORITY_networking = "5"

# This should only be incremented on significant changes that will
# cause compatibility issues with other layers
LAYERVERSION_networking = "1"

LAYERDEPENDS_networking = "core"
```

## meta-oe/conf/distro/include/meta_oe_security_flags.inc
```bitbake
# Build errors with the pie options enabled
SECURITY_CFLAGS_pn-lvm2 = "${SECURITY_NO_PIE_CFLAGS}"
SECURITY_CFLAGS_pn-rrdtool = "${SECURITY_NO_PIE_CFLAGS}"

# This has text reloc errors with the pie options enabled
SECURITY_CFLAGS_pn-llvm3.3 = "${SECURITY_NO_PIE_CFLAGS}"
SECURITY_CFLAGS_pn-mozjs = "${SECURITY_NO_PIE_CFLAGS}"
SECURITY_CFLAGS_pn-openldap = "${SECURITY_NO_PIE_CFLAGS}"
SECURITY_CFLAGS_pn-s3c64xx-gpio = "${SECURITY_NO_PIE_CFLAGS}"
SECURITY_CFLAGS_pn-s3c24xx-gpio = "${SECURITY_NO_PIE_CFLAGS}"
SECURITY_CFLAGS_pn-cpufrequtils = "${SECURITY_NO_PIE_CFLAGS}"
SECURITY_CFLAGS_pn-libcec = "${SECURITY_NO_PIE_CFLAGS}"
SECURITY_CFLAGS_pn-libmodplug = "${SECURITY_NO_PIE_CFLAGS}"
SECURITY_CFLAGS_pn-libcdio = "${SECURITY_NO_PIE_CFLAGS}"

#| /mnt/b/build/tmp-glibc/sysroots/intel-corei7-64/usr/lib/libc_nonshared.a(elf-init.oS): In function `__libc_csu_init':
#| /usr/src/debug/glibc/2.24-r0/git/csu/elf-init.c:86: undefined reference to `__init_array_start'

SECURITY_CFLAGS_pn-libvdpau = "${SECURITY_NO_PIE_CFLAGS}"
```

## meta-oe/conf/layer.conf
```bitbake
# It really depends on order of the layers appearing in BBLAYERS
# variable in toplevel bblayers.conf file, where bitbake will search
# for .inc files and others where bitbake uses BBPATH since it will
# search the directories from first to last as specified in BBPATH
# Therefore if you want a given layer to be considered high priority
# for the .inc and .conf etc. then consider it adding at the beginning
# of BBPATH. For bblayers bitbake will use BBFILES_PRIORITY to resolve
# the recipe contention so the order of directories in BBFILES does 
# not matter.

# We have a conf and classes directory, append to BBPATH
BBPATH .= ":${LAYERDIR}"

# We have a recipes directory, add to BBFILES
BBFILES += "${LAYERDIR}/recipes-*/*/*.bb ${LAYERDIR}/recipes-*/*/*.bbappend"

BBFILE_COLLECTIONS += "openembedded-layer"
BBFILE_PATTERN_openembedded-layer := "^${LAYERDIR}/"

# Define the priority for recipes (.bb files) from this layer,
# choosing carefully how this layer interacts with all of the
# other layers.

BBFILE_PRIORITY_openembedded-layer = "6"

LICENSE_PATH += "${LAYERDIR}/licenses"

SIGGEN_EXCLUDERECIPES_ABISAFE += " \
  mplayer-common \
  fbset-modes \
  gpsd-machine-conf \
  distro-feed-configs \
  ca-certificates \
"

SIGGEN_EXCLUDE_SAFE_RECIPE_DEPS += " \
  usb-modeswitch-data->usb-modeswitch \
"

# ttf.inc inherits fontcache which adds fontconfig-utils to RDEPENDS
SIGGEN_EXCLUDE_SAFE_RECIPE_DEPS += " \
  terminus-font->fontconfig \
  ttf-arphic-uming->fontconfig \
  ttf-dejavu->fontconfig \
  ttf-droid->fontconfig \
  ttf-gentium->fontconfig \
  ttf-hunkyfonts->fontconfig \
  ttf-inconsolata->fontconfig \
  ttf-liberation->fontconfig \
  ttf-mplus->fontconfig \
  ttf-sazanami->fontconfig \
  ttf-tlwg->fontconfig \
  ttf-ubuntu-font-family->fontconfig \
  ttf-wqy-zenhei->fontconfig \
"

FREESMARTPHONE_GIT = "git://git.freesmartphone.org"
```

## meta-oe/conf/machine/include/davinci.inc
```bitbake
require conf/machine/include/tune-arm926ejs.inc

# Increase this everytime you change something in the kernel
MACHINE_KERNEL_PR = "r50"

TARGET_ARCH = "arm"

KERNEL_IMAGETYPE = "uImage"

PREFERRED_PROVIDER_virtual/kernel = "linux-davinci"

PREFERRED_PROVIDER_virtual/bootloader = "u-boot"
UBOOT_MACHINE = "davinci_dvevm_config"

UBOOT_ENTRYPOINT = "0x80008000"
UBOOT_LOADADDRESS = "0x80008000"

EXTRA_IMAGEDEPENDS += "u-boot"

SERIAL_CONSOLE ?= "115200 ttyS0"
EXTRA_IMAGECMD_jffs2 = "--pad --little-endian --eraseblock=0x20000 -n"

#ROOT_FLASH_SIZE = "29"

MACHINE_FEATURES = "kernel26 serial ethernet usbhost usbgadget mmc alsa"
```

## meta-oe/conf/machine/include/omap3.inc
```bitbake
SOC_FAMILY = "omap3"
TARGET_ARCH = "arm"

require conf/machine/include/tune-cortexa8.inc
PREFERRED_PROVIDER_virtual/kernel = "linux-omap"
# Increase this everytime you change something in the kernel
MACHINE_KERNEL_PR = "r99"

KERNEL_IMAGETYPE = "uImage"

UBOOT_ENTRYPOINT = "0x80008000"
UBOOT_LOADADDRESS = "0x80008000"

EXTRA_IMAGEDEPENDS += "u-boot x-load"
```

## meta-oe/conf/machine/include/tune-cortexa8.inc
```bitbake
# Instead of using -mfpu=vfp[2] we can use -mfpu=neon to make use of gcc intrinsics[1] and vectorize loops with -ftree-vectorize[3]
# [1] http://gcc.gnu.org/onlinedocs/gcc/ARM-NEON-Intrinsics.html
# [2] http://gcc.gnu.org/onlinedocs/gcc/ARM-Options.html 
# [3] https://support.codesourcery.com/GNUToolchain/kbentry29

# Can be 'softfp' or 'hardfp'
ARM_FP_MODE ?= "softfp"

ARM_FP_OPT = "${@['-mfloat-abi=softfp', '-mfloat-abi=hard'][bb.data.getVar('ARM_FP_MODE', d, 1) == 'hardfp']}"
ARM_FP_PACKAGESUFFIX = "${@['', '-hardfp'][bb.data.getVar('ARM_FP_MODE', d, 1) == 'hardfp']}"

TARGET_CC_ARCH = "-march=armv7-a -mtune=cortex-a8 -mfpu=neon ${ARM_FP_OPT}"

FEED_ARCH = "armv7a${ARM_FP_PACKAGESUFFIX}"
BASE_PACKAGE_ARCH = "armv7a${ARM_FP_PACKAGESUFFIX}"

PACKAGE_EXTRA_ARCHS += "armv4 armv4t armv5te armv6 armv7 armv7a${ARM_FP_PACKAGESUFFIX}"
```

## meta-python/conf/layer.conf
```bitbake
# We might have a conf and classes directory, append to BBPATH
BBPATH .= ":${LAYERDIR}"

# We have recipes directories, add to BBFILES
BBFILES += "${LAYERDIR}/recipes*/*/*.bb ${LAYERDIR}/recipes*/*/*.bbappend"

BBFILE_COLLECTIONS += "meta-python"
BBFILE_PATTERN_meta-python := "^${LAYERDIR}/"
BBFILE_PRIORITY_meta-python = "7"
```

## meta-webserver/conf/layer.conf
```bitbake
# Layer configuration for meta-webserver layer
# Copyright 2012 Intel Corporation

# We have a conf and classes directory, add to BBPATH
BBPATH .= ":${LAYERDIR}"

# We have various recipe-* directories, add to BBFILES
BBFILES += "${LAYERDIR}/recipes-*/*/*.bb ${LAYERDIR}/recipes-*/*/*.bbappend"

BBFILE_COLLECTIONS += "webserver"
BBFILE_PATTERN_webserver := "^${LAYERDIR}/"
BBFILE_PRIORITY_webserver = "6"
```

## meta-xfce/conf/layer.conf
```bitbake
# We have a conf and classes directory, append to BBPATH
BBPATH .= ":${LAYERDIR}"

# We have a recipes directory, add to BBFILES
BBFILES += "${LAYERDIR}/recipes-*/*/*.bb ${LAYERDIR}/recipes-*/*/*.bbappend"

BBFILE_COLLECTIONS += "xfce-layer"
BBFILE_PATTERN_xfce-layer := "^${LAYERDIR}/"
BBFILE_PRIORITY_xfce-layer = "7"
```

## toolchain-layer/conf/layer.conf
```bitbake
# It really depends on order of the layers appearing in BBLAYERS
# variable in toplevel bblayers.conf file, where bitbake will search
# for .inc files and others where bitbake uses BBPATH since it will
# search the directories from first to last as specified in BBPATH
# Therefore if you want a given layer to be considered high priority
# for the .inc and .conf etc. then consider it adding at the beginning
# of BBPATH. For bblayers bitbake will use BBFILES_PRIORITY to resolve
# the recipe contention so the order of directories in BBFILES does 
# not matter.

# We have a conf directory, append to BBPATH
BBPATH .= ":${LAYERDIR}"

# We have a recipes directory, add to BBFILES
BBFILES += "${LAYERDIR}/recipes-*/*/*.bb ${LAYERDIR}/recipes-*/*/*.bbappend"

BBFILE_COLLECTIONS += "toolchain-layer"
BBFILE_PATTERN_toolchain-layer := "^${LAYERDIR}/"

# Define the priority for recipes (.bb files) from this layer,
# choosing carefully how this layer interacts with all of the
# other layers.

BBFILE_PRIORITY_toolchain-layer = "6"

# This should only be incremented on significant changes that will
# cause compatibility issues with other layers
LAYERVERSION_toolchain-layer = "1"

LAYERDEPENDS_toolchain-layer = "core"
```
